## drivers/input/touchscreen/focaltech_touch_spi/Kconfig
```kconfig
#
# SPI Focaltech Touchscreen driver configuration
#

config TOUCHSCREEN_FTS_SPI
	tristate "SPI Focaltech Touchscreen"
	depends on SPI_MASTER
	help
	  Say Y here if you have an SPI Focaltech touch panel.
	  If unsure, say N.
```

## drivers/input/touchscreen/goodix_berlin_driver/Kconfig
```kconfig
#
# Goodix touchscreen driver configuration
#
menuconfig TOUCHSCREEN_GOODIX_BRL
	tristate "Goodix berlin touchscreen"
	help
	  Say Y here if you have a Goodix berlin series touch controller
	  to your system.

	  If build module, say M.
	  If unsure, say N.

if TOUCHSCREEN_GOODIX_BRL

config TOUCHSCREEN_GOODIX_BRL_I2C
	bool "support I2C bus connection"
	help
		Say Y here if the touchscreen is connected via I2C bus.

config TOUCHSCREEN_GOODIX_BRL_SPI
	bool "support SPI bus connection"
	help
		Say Y here if the touchscreen is connected via SPI bus.

config TOUCHSCREEN_GOODIX_BRL_GESTURE
	bool "support gesture"
	help
		Say Y here if support gesture

config TOUCHSCREEN_GOODIX_BRL_INSPECT
	bool "support gesture"
	help
		Say Y here if support inspect

config TOUCHSCREEN_GOODIX_BRL_TOOLS
	bool "support gesture"
	help
		Say Y here if support tools

config TOUCHSCREEN_GOODIX_BRL_FW_UPDATE
	bool "support gesture"
	help
		Say Y here if support fw update

endif
```

## drivers/misc/quectel_reset/Kconfig
```kconfig
# SPDX-License-Identifier: GPL-2.0-only
#
# QUECTEL MODULE RESET driver configuration
#

config QUECTEL_MODULE_RESET
	tristate "QUECTEL MODULE RESET Driver"
	help
	  Say Y here if you have a QUECTEL MODULE RESET.

	  If unsure, say N.
	  To compile this driver as a module, choose M here: the
	  module will be called quectel_module_ctrl.
```

## drivers/platform/razer/Kconfig
```kconfig
# Razer configuration options

config MACH_RAZER
	bool "Razer board"
	depends on ARCH_QCOM
	help
	  Support for Razer boards.

config MACH_RAZER_LAHAINA
	bool "Razer Lahaina boards"
	depends on ARCH_LAHAINA
	select MACH_RAZER
	help
	  Support for Razer Lahaina boards.

menu "Razer board selection"

config MACH_RAZER_NICOLE
	bool "Razer Nicole board"
	select MACH_RAZER_LAHAINA
	help
	  Support for Razer Edge, codenamed Nicole.

endmenu
```
