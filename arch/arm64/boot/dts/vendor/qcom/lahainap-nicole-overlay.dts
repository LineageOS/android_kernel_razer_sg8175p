/dts-v1/;
/plugin/;

#include "lahainap-nicole.dtsi"

/ {
	model = "Qualcomm Technologies, Inc. Nicole";
	compatible = "qcom,lahaina-hdk", "qcom,lahaina", "qcom,hdk";
	qcom,board-id = <0x1001f 0x02>;
};
